## config/boards/shields/cradio_dongle/Kconfig.defconfig
```kconfig
if SHIELD_CRADIO_DONGLE

config ZMK_KEYBOARD_NAME
    default "Cradio"

config ZMK_SPLIT
    default y

config ZMK_SPLIT_ROLE_CENTRAL
    default y

config ZMK_SPLIT_BLE_CENTRAL_PERIPHERALS
    default 2

config ZMK_USB
    default y

config ZMK_BLE
    default y

endif

if SHIELD_CRADIO_DONGLE_LEFT

config ZMK_KEYBOARD_NAME
    default "Cradio Left"

config ZMK_SPLIT
    default y

config ZMK_BLE
    default y

endif

if SHIELD_CRADIO_DONGLE_RIGHT

config ZMK_KEYBOARD_NAME
    default "Cradio Right"

config ZMK_SPLIT
    default y

config ZMK_BLE
    default y

endif
```

## config/boards/shields/cradio_dongle/Kconfig.shield
```kconfig
config SHIELD_CRADIO_DONGLE
    def_bool $(shields_list_contains,cradio_dongle)

config SHIELD_CRADIO_DONGLE_LEFT
    def_bool $(shields_list_contains,cradio_dongle_left)

config SHIELD_CRADIO_DONGLE_RIGHT
    def_bool $(shields_list_contains,cradio_dongle_right)
```
